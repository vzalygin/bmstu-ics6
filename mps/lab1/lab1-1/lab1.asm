.include "m8515def.inc" ;файл определений для ATmega8515
.def reg_led = r20 ;регистр для текущего состояния светодиодов
.def temp = r19 ;регистр для пересылок (временный)
.org $000
	rjmp INIT
;***Инициализация***
INIT:
	ldi reg_led,0xFE ;начальное значение: reg_led.0 = 0 для включения LED0
	ser temp
	out DDRB,temp ;настройка линий порта PB на вывод
	sec ;C=1
;***Основной цикл***
LOOP:
	out PORTB,reg_led ;вывод содержимого регистра в порт

ldi r20, 10
l1: ldi r21, 255
l2: ldi r22, 255
l3: dec r22
	brne l3
	dec r21
	brne l2
	dec r20
	brne l1


	;***Задержка в виде вложенных циклов***
	ldi r17,10
d1: ldi r18,10 ;загрузка начального значения в регистр

d2: dec r18 ;уменьшение значения регистра на 1
	brne d2 ;переход по метке, если "не равно"
	dec r17
	brne d1
	rol reg_led ;циклический сдвиг регистра влево через С
	rjmp LOOP ;переход к началу тела цикла
